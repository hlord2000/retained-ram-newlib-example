## sample.yaml
```
# This file is provided so that the application can be compiled using Twister,
# the Zephyr testing tool. In this file, multiple combinations can be specified,
# so that you can easily test all of them locally or in CI.
sample:
  description: Retained RAM and newlib heap example
  name: retained-ram-newlib-example
common:
  sysbuild: true
  build_only: true
  integration_platforms:
    - nrf54l15dk/nrf54l15/cpuapp
tests:
  app.pm: {}
  app.no_pm:
    extra_args:
      - SB_CONFIG_PARTITION_MANAGER=n
      - EXTRA_DTC_OVERLAY_FILE=boards/nrf54l15dk_nrf54l15_cpuapp_no_pm.overlay
```

## prj.conf
```kconfig
# Copyright (c) 2021 Nordic Semiconductor ASA
# SPDX-License-Identifier: Apache-2.0
#
# This file contains selected Kconfig options for the application.

CONFIG_NEWLIB_LIBC=y
CONFIG_NEWLIB_LIBC_FLOAT_PRINTF=y
CONFIG_CONSOLE=y
CONFIG_UART_CONSOLE=y
CONFIG_PRINTK=y
```

## boards/nrf54l15dk_nrf54l15_cpuapp.overlay
```dts
/*
 * Copyright (c) 2025 Nordic Semiconductor ASA
 * SPDX-License-Identifier: Apache-2.0
 */

/ {
	retained_region: cpuapp_sram@2002e000 {
		compatible = "zephyr,memory-region", "mmio-sram";
		reg = <0x2002e000 DT_SIZE_K(4)>;
		zephyr,memory-region = "RetainedMem";
		status = "okay";

		retainedmem0: retainedmem {
			compatible = "zephyr,retained-ram";
			status = "okay";
		};
	};

	aliases {
		retainedmemdevice = &retainedmem0;
	};
};
```

## boards/nrf54l15dk_nrf54l15_cpuapp_no_pm.overlay
```dts
/*
 * Copyright (c) 2026 Nordic Semiconductor ASA
 * SPDX-License-Identifier: Apache-2.0
 */

&cpuapp_sram {
	/* Shrink SRAM so the retained block is no longer part of general-purpose RAM. */
	reg = <0x20000000 DT_SIZE_K(184)>;
	ranges = <0x0 0x20000000 0x2e000>;
};
```

## src/main.c
```c
/*
 * Copyright (c) 2021 Nordic Semiconductor ASA
 * SPDX-License-Identifier: Apache-2.0
 */

#include <zephyr/autoconf.h>
#include <zephyr/devicetree.h>
#include <zephyr/kernel.h>

#include <errno.h>
#include <stdint.h>
#include <stdio.h>
#include <stddef.h>

#if IS_ENABLED(CONFIG_PARTITION_MANAGER_ENABLED)
#include <pm_config.h>
#endif

#define RETAINED_REGION_NODE DT_NODELABEL(retained_region)

extern char _end[];
extern char __kernel_ram_end[];
extern void *sbrk(intptr_t increment);

int main(void)
{
	char float_buf[16];
	uintptr_t retained = DT_REG_ADDR(RETAINED_REGION_NODE);
	size_t retained_size = DT_REG_SIZE(RETAINED_REGION_NODE);
	uintptr_t heap_base = (uintptr_t)sbrk(0);
	ptrdiff_t delta = (ptrdiff_t)(retained - heap_base);
	void *ret;
	uintptr_t cross;

	snprintf(float_buf, sizeof(float_buf), "%.2f", 3.14);

	printk("retained-ram-newlib example\n");
	printk("PM=%d CONFIG_SRAM_SIZE=%d KB float=%s\n",
	       IS_ENABLED(CONFIG_PARTITION_MANAGER_ENABLED),
	       CONFIG_SRAM_SIZE, float_buf);
	printk("_end=%p __kernel_ram_end=%p retained=%p size=0x%zx delta=0x%tx\n",
	       _end, __kernel_ram_end, (void *)retained, retained_size, delta);

#if IS_ENABLED(CONFIG_PARTITION_MANAGER_ENABLED)
	printk("PM_SRAM_ADDRESS=%p PM_SRAM_SIZE=0x%x\n",
	       (void *)PM_SRAM_ADDRESS, PM_SRAM_SIZE);
#endif

	errno = 0;
	ret = sbrk(delta);
	cross = (uintptr_t)sbrk(16);

	printk("ret=%p cross=%p errno=%d\n", ret, (void *)cross, errno);
	*(volatile uint32_t *)cross = 0xdeadbeef;
	printk("wrote 0xdeadbeef to %p\n", (void *)cross);

	return 0;
}
```
